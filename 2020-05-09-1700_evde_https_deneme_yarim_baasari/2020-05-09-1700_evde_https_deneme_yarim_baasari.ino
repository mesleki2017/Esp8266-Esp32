#include <SPI.h>
#include <Adafruit_GFX.h>
#include <Adafruit_ILI9341.h>
//#include <Fonts/FreeSansOblique9pt7b.h>
#include <ESP8266HTTPClient.h>
#include <ESP8266WiFi.h>
#include <WiFiClient.h>
#include <ESP8266WebServer.h>
#include <ESP8266WebServerSecure.h>

#include <WebSocketsServer.h>
#include <FS.h> 
#include <XPT2046_Touchscreen.h>

////////////////////////////////////////////////////////////////
#define TIRQ_PIN  2
#define TFT_CS D0  //for D1 mini or TFT I2C Connector Shield (V1.1.0 or later)
#define TFT_DC D8  //for D1 mini or TFT I2C Connector Shield (V1.1.0 or later)
#define TFT_RST -1 //for D1 mini or TFT I2C Connector Shield (V1.1.0 or later)
#define TS_CS D3   //for D1 mini or TFT I2C Connector Shield (V1.1.0 or later)
Adafruit_ILI9341 tft = Adafruit_ILI9341(TFT_CS, TFT_DC, TFT_RST);
XPT2046_Touchscreen ts(TS_CS);
//////////////////////////////////////////////////////////
int rrrr=0;
//Enter your SSID and PASSWORD
const char* ssid = "NetMASTER Uydunet-E4B0";
const char* password = "mukerremcesur7106";

ESP8266WebServerSecure server(443);
WebSocketsServer webSocket = WebSocketsServer(81);
///////////////////////////////////
static const uint8_t x509[] PROGMEM = {
  0x30, 0x82, 0x01, 0x3d, 0x30, 0x81, 0xe8, 0x02, 0x09, 0x00, 0xfe, 0x56,
  0x46, 0xf2, 0x78, 0xc6, 0x51, 0x17, 0x30, 0x0d, 0x06, 0x09, 0x2a, 0x86,
  0x48, 0x86, 0xf7, 0x0d, 0x01, 0x01, 0x0b, 0x05, 0x00, 0x30, 0x26, 0x31,
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  0x9e, 0x12, 0x67, 0x6b, 0x98, 0x7e, 0xd5, 0x80, 0x8f
};

// And so is the key.  These could also be in DRAM
static const uint8_t rsakey[] PROGMEM = {
  0x30, 0x82, 0x01, 0x3a, 0x02, 0x01, 0x00, 0x02, 0x41, 0x00, 0xc6, 0x72,
  0x6c, 0x12, 0xe1, 0x20, 0x4d, 0x10, 0x0c, 0xf7, 0x3a, 0x2a, 0x5a, 0x49,
  0xe2, 0x2d, 0xc9, 0x7a, 0x63, 0x1d, 0xef, 0xc6, 0xbb, 0xa3, 0xd6, 0x6f,
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  0xd5, 0xdf, 0x34, 0xeb, 0x26, 0x03
};


////////////////////////////
void setup(void){

  pinMode(LED_BUILTIN, OUTPUT);
  digitalWrite(LED_BUILTIN,HIGH);
  //////////////////////////////////////////
  tft.begin();
  tft.setRotation(1);
  tft.setTextWrap(false);//yenibilgi2019-12-11:yazi satiri doldurdugunda asagi gecmesin
  tft.setTextColor(0x0000,0xffff); tft.setTextSize(2);

  tft.fillRect(0,0, 320,120, 0xffff);
  tft.fillRect(0,120,320,240,0xffff );
///////////////////////////////////////////
  ts.begin();
  ts.setRotation(1);
  /////////////////////////////////////////
  //ESP.eraseConfig();//2019-12-19yeni esp zaman zaman wifi server uzerinden gerekli dosyalara tam bağlanamiyordu. bazen iyi bazen kotu idi. belki bu cozum olur.emin degilim
  Serial.begin(115200);
  SPIFFS.begin();
  if(SPIFFS.begin()){
     Serial.println("SPIFFS dosya sistemi aktif");
    //return;
  }
 
  File file2 = SPIFFS.open("/index.html", "r");
  if(file2){
    Serial.println("index.html acildi");  
  }
     File file7 = SPIFFS.open("/p5.min.js", "r");///deneme
  if(file7){
    Serial.println("p5.min.js acildi");
  }

   
  //WiFi.softAP(ssid, password);
 // IPAddress IP = WiFi.softAPIP();
WiFi.mode(WIFI_STA);
WiFi.begin(ssid, password);
while (WiFi.status() != WL_CONNECTED) {
Serial.print("Connecting..");
tft.setCursor(10, 10);tft.print("baglaniyor");
delay(1000);
}
tft.setCursor(10, 10);tft.println("baglandi..");
tft.setCursor(10, 50);tft.println(WiFi.localIP());
server.getServer().setServerKeyAndCert_P(rsakey, sizeof(rsakey), x509, sizeof(x509));
server.serveStatic("/", SPIFFS, "/index.html"); 
server.serveStatic("/p5.min.js", SPIFFS, "/p5.min.js");
server.begin();
  delay(2000);
  Serial.println("setupbitti");
  webSocket.begin();
  webSocket.onEvent(webSocketEvent);

}
  
void loop(void){

server.handleClient(); 
webSocket.loop();

String xekseni;
String yekseni;
String basinc;

  TS_Point p = ts.getPoint();
  xekseni=String(900*(p.x-300)/3000);
  yekseni=String(600*(p.y-480)/3000);
  basinc =String(p.z/10);
  webSocket.broadcastTXT(xekseni+","+yekseni+","+basinc);
  tft.setCursor(20, 200);tft.print(p.x);


}
void webSocketEvent(byte num, WStype_t type, uint8_t * payload, size_t length)
{
  if(type == WStype_TEXT)
  {
      if (payload[0] == '0')
      {
          digitalWrite(LED_BUILTIN, LOW);
          Serial.println("LED=off");        
      }
      else if (payload[0] == '1')
      {
          digitalWrite(LED_BUILTIN, HIGH);
          Serial.println("LED=on");        
      }
  }
 
  else 
  {
    Serial.print("WStype = ");   Serial.println(type);  
    Serial.print("WS payload = ");
    for(int i = 0; i < length; i++) { Serial.print((char) payload[i]); }
    Serial.println();
 
  }
}
